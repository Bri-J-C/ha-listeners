## firmware/sdkconfig.defaults
```kconfig
# HA Intercom ESP32-S3 Configuration

# Target chip
CONFIG_IDF_TARGET="esp32s3"

# Flash size (4MB minimum recommended)
CONFIG_ESPTOOLPY_FLASHSIZE_4MB=y

# CPU frequency
CONFIG_ESP_DEFAULT_CPU_FREQ_MHZ_240=y

# PSRAM - enabled with safe fallback (won't crash if board lacks PSRAM)
CONFIG_SPIRAM=y
CONFIG_SPIRAM_MODE_OCT=y
CONFIG_SPIRAM_SPEED_80M=y
CONFIG_SPIRAM_IGNORE_NOTFOUND=y
CONFIG_SPIRAM_MALLOC_ALWAYSINTERNAL=4096
CONFIG_SPIRAM_TRY_ALLOCATE_WIFI_LWIP=y
CONFIG_SPIRAM_ALLOW_BSS_SEG_EXTERNAL_MEMORY=y

# WiFi
CONFIG_ESP_WIFI_STATIC_RX_BUFFER_NUM=10
CONFIG_ESP_WIFI_DYNAMIC_RX_BUFFER_NUM=32
CONFIG_ESP_WIFI_DYNAMIC_TX_BUFFER_NUM=32

# lwIP (networking) - increased for real-time audio
CONFIG_LWIP_UDP_RECVMBOX_SIZE=64
CONFIG_LWIP_TCPIP_RECVMBOX_SIZE=64
CONFIG_LWIP_MAX_UDP_PCBS=16
CONFIG_LWIP_MAX_SOCKETS=16

# Disable WiFi power save for better multicast receive
CONFIG_ESP_WIFI_STA_DISCONNECTED_PM_ENABLE=n

# WiFi buffers for audio streaming
CONFIG_ESP_WIFI_DYNAMIC_RX_BUFFER_NUM=64
CONFIG_ESP_WIFI_RX_BA_WIN=16

# FreeRTOS
CONFIG_FREERTOS_HZ=1000
CONFIG_FREERTOS_TIMER_TASK_STACK_DEPTH=3072

# Logging
CONFIG_LOG_DEFAULT_LEVEL_INFO=y

# USB CDC Console (ESP32-S3 native USB)
CONFIG_ESP_CONSOLE_USB_CDC=y
CONFIG_ESP_CONSOLE_SECONDARY_NONE=y

# Partition table
CONFIG_PARTITION_TABLE_CUSTOM=y
CONFIG_PARTITION_TABLE_CUSTOM_FILENAME="partitions.csv"
```
